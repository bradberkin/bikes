#include <SD.h>
#include <ArduinoSound.h>

// Variable width font; first byte equals width
const PROGMEM unsigned char play_8[] = {0x30,0x00,0x00,0x00,0x00,0x00,0x00,0x00,0x00,0x00,0x00,0x00,0x00,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0x00,0x00};
const PROGMEM unsigned char play_9[] = {0x30,0x00,0x00,0x00,0x00,0x00,0x00,0x00,0x00,0x00,0x00,0x00,0x00,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0x00,0x00};
const PROGMEM unsigned char play_f_low[] = {0x30,0x00,0x00,0x00,0x00,0x00,0x00,0x00,0x00,0x00,0x00,0x00,0x00,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0x00,0x00};
const PROGMEM unsigned char play_4[] = {0x30,0x00,0x00,0x00,0x00,0x00,0x00,0x00,0x00,0x00,0x00,0x00,0x00,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0x00,0x00};
const PROGMEM unsigned char play_5[] = {0x30,0x00,0x00,0x00,0x00,0x00,0x00,0x00,0x00,0x00,0x00,0x00,0x00,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0x00,0x00};
const PROGMEM unsigned char play_7[] = {0x30,0x00,0x00,0x00,0x00,0x00,0x00,0x00,0x00,0x00,0x00,0x00,0x00,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0x00,0x00};
const PROGMEM unsigned char play_6[] = {0x30,0x00,0x00,0x00,0x00,0x00,0x00,0x00,0x00,0x00,0x00,0x00,0x00,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0x00,0x00};
const PROGMEM unsigned char play_2[] = {0x30,0x00,0x00,0x00,0x00,0x00,0x00,0x00,0x00,0x00,0x00,0x00,0x00,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0x00,0x00};
const PROGMEM unsigned char play_period[] = {0x24,0x00,0x00,0x00,0x00,0x00,0x00,0x00,0x00,0x00,0x00,0x00,0x00,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0x00,0x00};
const PROGMEM unsigned char play_3[] = {0x30,0x00,0x00,0x00,0x00,0x00,0x00,0x00,0x00,0x00,0x00,0x00,0x00,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0x00,0x00};
const PROGMEM unsigned char play_t_low[] = {0x30,0x00,0x00,0x00,0x00,0x00,0x00,0x00,0x00,0x00,0x00,0x00,0x00,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0x00,0x00};
const PROGMEM unsigned char play_1[] = {0x30,0x00,0x00,0x00,0x00,0x00,0x00,0x00,0x00,0x00,0x00,0x00,0x00,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0x00,0x00};
const PROGMEM unsigned char play_0[] = {0x30,0x00,0x00,0x00,0x00,0x00,0x00,0x00,0x00,0x00,0x00,0x00,0x00,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0x00,0x00};
const unsigned char* play_type[96];

// Battery
int batteryVal = 0;

// Sonar
#define sonarPin A1
unsigned int sonarVal = 0;
double sonarFeet = 100;

// Speaker
#define speakerLRCPin 3
#define speakerBCLKPin 2
#define speakerDINPin A6
SDWaveFile wav = NULL;

/* 
 *  OLED
 *  pins 19, 20 hardwired to ground: 4-wire serial interface
 */
#define oledRegPin A5 // pin4 on OLED
#define oledResetPin A2 // pin16 on OLED
#define oledChipPin 4 // pin17 on OLED

// Parallel interface
#define oledReadWritePin A3 // pin5 on OLED
#define oledOperationEnablePin A4 // pin6 on OLED
#define oledDataPin0 12 // pin7 on OLED
#define oledDataPin1 11 // pin8 on OLED
#define oledDataPin2 10 // pin9 on OLED
#define oledDataPin3 9 // pin10 on OLED
#define oledDataPin4 8 // pin11 on OLED
#define oledDataPin5 7 // pin12 on OLED
#define oledDataPin6 6 // pin13 on OLED
#define oledDataPin7 5 // pin14 on OLED

// Serial interface
//#define oledClockPin 5 // pin7 on OLED
//#define oledDataPin 10 // pin8 on OLED

void setup() {
  Serial.begin(9600);
  
  pinMode(sonarPin, INPUT);
  
  pinMode(oledRegPin, OUTPUT);
  pinMode(oledResetPin, OUTPUT);
  pinMode(oledChipPin, OUTPUT);
  // Parallel interface
  pinMode(oledReadWritePin, OUTPUT);
  pinMode(oledOperationEnablePin, OUTPUT);
  pinMode(oledDataPin0, OUTPUT);
  pinMode(oledDataPin1, OUTPUT);
  pinMode(oledDataPin2, OUTPUT);
  pinMode(oledDataPin3, OUTPUT);
  pinMode(oledDataPin4, OUTPUT);
  pinMode(oledDataPin5, OUTPUT);
  pinMode(oledDataPin6, OUTPUT);
  pinMode(oledDataPin7, OUTPUT);
  // Serial interface
  //pinMode(oledClockPin, OUTPUT);
  //pinMode(oledDataPin, OUTPUT);
  digitalWrite(oledResetPin, LOW);
  delay(30);
  digitalWrite(oledResetPin, HIGH);
  delay(30);
  oledInit();
  delay(30);
  oledClear();
  delay(30);

  play_type[13] = play_period;
  play_type[15] = play_0;
  play_type[16] = play_1;
  play_type[17] = play_2;
  play_type[18] = play_3;
  play_type[19] = play_4;
  play_type[20] = play_5;
  play_type[21] = play_6;
  play_type[22] = play_7;
  play_type[23] = play_8;
  play_type[24] = play_9;
  play_type[69] = play_f_low;
  play_type[83] = play_t_low;

  if (!SD.begin()) {
    Serial.println("SD init failed");
    return;
  }
  wav = SDWaveFile("cardi.wav");
  if (!wav) {
    Serial.println("Wave file bad");
    return;
  }
  AudioOutI2S.volume(25);
  if (!AudioOutI2S.canPlay(wav)) {
    Serial.println("Can't play wave file");
    return;
  }
}

void loop() {
  sonarVal = analogRead(sonarPin); // 10-bit read by default
  sonarFeet = sonarVal*5.0/305;
  Serial.println(sonarFeet);

  oledGo(String(sonarFeet, 1));
  //if (sonarFeet < 1.5)
    //speakerGo();
    
  // Battery
  /*batteryVal = analogRead(ADC_BATTERY);
  double b = batteryVal/1023.0*3.7;
  Serial.print("Battery: ");
  Serial.println(b);*/
}

// Speaker
void speakerGo() {
  if (wav != NULL && !AudioOutI2S.isPlaying()) {
    AudioOutI2S.play(wav);
    delay(400);
  }
}

/*
 * OLED
 */
void oledGo(String str) {
  unsigned int char_index, row, row_start, row_end, col, col_start, col_end, width_pixels, width_cols, byte_counter;
  unsigned char char_val;
  const unsigned char* char_pixels;

  row_start = 0;
  row_end = 63;
  col_start = 28;
  for (char_index=0; char_index<str.length(); char_index++) {
    char_val = str.charAt(char_index);
    char_pixels = play_type[char_val-32-1];
    width_pixels = char_pixels[0]; // byte 0 equals width
    width_cols = width_pixels/4;
    col_end = col_start+width_cols-1;

    setRowAddress(row_start, row_end);
    setColumnAddress(col_start, col_end);
    setWriteRAM();
  
    byte_counter=1; // byte 0 equals width
    for (row=0; row<64; row++) {
      for (col=0; col<width_cols; col++) {
        oledData(char_pixels[byte_counter]);
        byte_counter++;
        oledData(char_pixels[byte_counter]);
        byte_counter++;
      }
    }
    row_start = 0;
    row_end = 63;
    col_start += width_cols;
    col_end += width_cols;
  }
  delay(300);
}

void oledData(unsigned char d) {
  unsigned int n;
  digitalWrite(oledChipPin, LOW); 
  digitalWrite(oledRegPin, HIGH);
  digitalWrite(oledReadWritePin, LOW);

  // Parallel interface
  if((d&0x80)==0x80)
    digitalWrite(oledDataPin7, HIGH);
  else
    digitalWrite(oledDataPin7, LOW);
  while(0);
  d=(d<<1);

  if((d&0x80)==0x80)
    digitalWrite(oledDataPin6, HIGH);
  else
    digitalWrite(oledDataPin6, LOW);
  while(0);
  d=(d<<1);
  
  if((d&0x80)==0x80)
    digitalWrite(oledDataPin5, HIGH);
  else
    digitalWrite(oledDataPin5, LOW);
  while(0);
  d=(d<<1);

  if((d&0x80)==0x80)
    digitalWrite(oledDataPin4, HIGH);
  else
    digitalWrite(oledDataPin4, LOW);
  while(0);
  d=(d<<1);

  if((d&0x80)==0x80)
    digitalWrite(oledDataPin3, HIGH);
  else
    digitalWrite(oledDataPin3, LOW);
  while(0);
  d=(d<<1);

  if((d&0x80)==0x80)
    digitalWrite(oledDataPin2, HIGH);
  else
    digitalWrite(oledDataPin2, LOW);
  while(0);
  d=(d<<1);

  if((d&0x80)==0x80)
    digitalWrite(oledDataPin1, HIGH);
  else
    digitalWrite(oledDataPin1, LOW);
  while(0);
  d=(d<<1);

  if((d&0x80)==0x80)
    digitalWrite(oledDataPin0, HIGH);
  else
    digitalWrite(oledDataPin0, LOW);
  while(0);
  d=(d<<1);

  digitalWrite(oledOperationEnablePin, HIGH);
  while(0);
  digitalWrite(oledOperationEnablePin, LOW);
  
  // Series interface
  /*for(n=0;n<8;n++){
    if((d&0x80)==0x80)
      digitalWrite(oledDataPin, HIGH);
    else
      digitalWrite(oledDataPin, LOW);
    while(0);
    d=(d<<1);
    
    digitalWrite(oledClockPin, LOW);
    while(0);
    digitalWrite(oledClockPin, HIGH);
    while(0);
    digitalWrite(oledClockPin, LOW); 
  }*/
  digitalWrite(oledChipPin, HIGH);
}

void oledCommand(unsigned char d) {
  unsigned int n;
  digitalWrite(oledChipPin, LOW); 
  digitalWrite(oledRegPin, LOW); 
  digitalWrite(oledReadWritePin, LOW);

  // Parallel interface
  if((d&0x80)==0x80)
    digitalWrite(oledDataPin7, HIGH);
  else
      digitalWrite(oledDataPin7, LOW);
  while(0);
  d=(d<<1);

  if((d&0x80)==0x80)
    digitalWrite(oledDataPin6, HIGH);
  else
    digitalWrite(oledDataPin6, LOW);
  while(0);
  d=(d<<1);
  
  if((d&0x80)==0x80)
    digitalWrite(oledDataPin5, HIGH);
  else
    digitalWrite(oledDataPin5, LOW);
  while(0);
  d=(d<<1);

  if((d&0x80)==0x80)
    digitalWrite(oledDataPin4, HIGH);
  else
    digitalWrite(oledDataPin4, LOW);
  while(0);
  d=(d<<1);

  if((d&0x80)==0x80)
    digitalWrite(oledDataPin3, HIGH);
  else
    digitalWrite(oledDataPin3, LOW);
  while(0);
  d=(d<<1);

  if((d&0x80)==0x80)
    digitalWrite(oledDataPin2, HIGH);
  else
    digitalWrite(oledDataPin2, LOW);
  while(0);
  d=(d<<1);

  if((d&0x80)==0x80)
    digitalWrite(oledDataPin1, HIGH);
  else
    digitalWrite(oledDataPin1, LOW);
  while(0);
  d=(d<<1);

  if((d&0x80)==0x80)
    digitalWrite(oledDataPin0, HIGH);
  else
    digitalWrite(oledDataPin0, LOW);
  while(0);
  d=(d<<1);

  digitalWrite(oledOperationEnablePin, HIGH);
  while(0);
  digitalWrite(oledOperationEnablePin, LOW);
  
  // Serial interface
  /*for(n=0;n<8;n++){
    if((d&0x80)==0x80)
      digitalWrite(oledDataPin, HIGH);
    else
      digitalWrite(oledDataPin, LOW);
    while(0);
    d=(d<<1);
    
    digitalWrite(oledClockPin, LOW);
    while(0);
    digitalWrite(oledClockPin, HIGH);
    while(0);
    digitalWrite(oledClockPin, LOW);
  }*/
  
  digitalWrite(oledChipPin, HIGH);
}

void setColumnAddress(unsigned char a, unsigned char b) {
  oledCommand(0x15); // Set Column Address
  oledData(a); // Default => 0x00
  oledData(b); // Default => 0x77
}

void setWriteRAM() {
  oledCommand(0x5C); // Enable MCU to Write DATA RAM
}

void setReadRAM() {
  oledCommand(0x5D); // Enable MCU to Read DATA RAM
}

void setRowAddress(unsigned char a, unsigned char b)
{
  oledCommand(0x75); // Set Row Start and End Address
  oledData(a); // Default => 0x00
  oledData(b); // Default => 0x7F
}

void setRemap(unsigned char a, unsigned char b) {
  oledCommand(0xA0); // Set Remap
  oledData(a); // Default => 0x00
  oledData(b); // Default => 0x00
}

void setDisplayStartLine(unsigned char a) {
  oledCommand(0xA1); // Set Display RAM Display Start Line
  oledData(a); // Default => 0x00
}

void setDisplayOffset(unsigned char a) {
  oledCommand(0xA2); // Set Verticle Shift
  oledData(a); // Default => 0x00
}

void displayMode(unsigned char a)
{
  oledCommand(a); // 0xA4 => Entire Display OFF 
                  // 0xA5 => Entire Display ON, all pixels Grayscale level 15
                  // 0xA6 => Normal Display (Default)
                  // 0xA7 => Inverse Display
}

void enablePartialDisplay(unsigned char a, unsigned char b) {
  oledCommand(0xA8);  // Turns ON partial mode 
  oledData(a); // Address of start row
  oledData(b); // Address of end row
}

void exitPartialDisplay() {
  oledCommand(0xA9); // Exit Partial Display Mode
}

void functionSelection(unsigned char a) {
  oledCommand(0xAB); // Function Selection
  oledData(a); // Default => 0x01
}

void setSleepMode(unsigned char a) {
  oledCommand(a);     // 0xAE => Sleep Mode ON
                  // 0xAF => Sleep Mode OFF
}

void setPhaseLength(unsigned char a) {
  oledCommand(0xB1); // Set Phase Length
  oledData(a); // Default => 0x97
}

void setDisplayClockOscillatorFrequency(unsigned char a) {
  oledCommand(0xB3); // Set Osc Frequency
  oledData(a);
}

void enableExternalVSL(unsigned char a, unsigned char b) {
  oledCommand(0xB4); // Enable External VSL
  oledData(a);
  oledData(b);
}

void setGPIO(unsigned char a) {
  oledCommand(0xB5); // Set GPIO
  oledData(a);
}

void setSecondPrechargePeriod(unsigned char a) {
  oledCommand(0xB6); // Set Second Precharge Period
  oledData(a);
}

void defaultGrayscaleCommand() {
  oledCommand(0xB9); // Set Default Grayscale
}

void setPrechargeVoltage(unsigned char a) {
  oledCommand(0xBB); // Set Precharge Voltage Level
  oledData(a); // Default => 0x17
}

void setVCOMHVoltage(unsigned char a) {
  oledCommand(0xBE); // Set Second Precharge Period
  oledData(a); // Default => 0x04
}

void setContrastControl(unsigned char a) {
  oledCommand(0xC1); // Set Contrast Control Level
  oledData(a); // Default => 0x7F
}

void masterContrastControl(unsigned char a) {
  oledCommand(0xC7); // Master Contrast Control
  oledData(a); // Default => 0x0F
}

void setMultiplexRatio(unsigned char a) {
  oledCommand(0xCA); // Set MUX Ratio
  oledData(a); // Default => 0x7F
}

void displayEnhancement(unsigned char a) {
  oledCommand(0xD1); // Display Enhancement
  oledData(a);
  oledData(0x20);
}

void setCommandLock(unsigned char a) {
  oledCommand(0xFD); // Set Lock/Unlock Commands
  oledData(a); // Default => 0x12
}

void oledInit() {
  setCommandLock(0x12); // Unlock commands for OLED
  setDisplayClockOscillatorFrequency(0xD1); // Set Display Clock / Oscillator Frequency
  setMultiplexRatio(0x3F); // Set Multiplex Ratio
  setDisplayOffset(0x00); // Set Display Offset 
  setDisplayStartLine(0x00); // Set Display Start Line
  setRemap(0x14,0x01); // Set Remap. (A[1]) & (A[4]) can be adjusted to flip display orientation
  setGPIO(0x00); // Set GPIO 
  functionSelection(0x00); // Function Selection
  enableExternalVSL(0xA0,0xB5); // Enable External VSL
  setContrastControl(0x7F); // Set Contrast Control
  masterContrastControl(0x0F); // Master Contrast Control
  defaultGrayscaleCommand(); // Default Linear Grayscale Table
  setPhaseLength(0x74); // Set Phase Length
  displayEnhancement(0xA2); // Display Enhancement
  setPrechargeVoltage(0x17); // Set Precharge Voltage
  setSecondPrechargePeriod(0x08); // Set Second Precharge Period
  setVCOMHVoltage(0x07); // Set VCOMH Voltage
  displayMode(0xA6); // Set Normal Display
  exitPartialDisplay(); // Exit Partial Display Mode
  setSleepMode(0xAF); // Sleep Mode OFF
}

void oledClear() {
  unsigned int r,c;
    
  setRowAddress(0,63);
  setColumnAddress(28,91);
  setWriteRAM();
  for (r=0; r<64; r++) {
    for (c=0; c<64; c++) {
      oledData(0x00);
      delayMicroseconds(100);
      oledData(0x00);
      delayMicroseconds(100);
    }
  }
}
